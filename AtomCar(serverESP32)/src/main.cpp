
#include <SPI.h>
#include <Wire.h>
#include <Adafruit_GFX.h>
#include <Adafruit_SSD1306.h>
#include <WiFi.h>
#include <Servo.h>
//#include <Arduino.h>
//#include <analogWrite.h>

Adafruit_SSD1306 display = Adafruit_SSD1306(128, 64, &Wire);

//Imagenes
const unsigned char PROGMEM atomo [] = {
0x00, 0x00, 0x00, 0x3F, 0x00, 0x00, 0x00, 0x00, 0x00, 0x00, 0x00, 0x00, 0x00, 0x00, 0x00, 0x00,
0x00, 0x00, 0x00, 0x7F, 0xC0, 0x00, 0x00, 0x00, 0x00, 0x00, 0x00, 0x00, 0x00, 0x00, 0x00, 0x00,
0x00, 0x00, 0x00, 0xFF, 0xE0, 0x00, 0x00, 0x00, 0x00, 0x00, 0x00, 0x00, 0x00, 0x00, 0x00, 0x00,
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0x00, 0x00, 0x00, 0x1E, 0x00, 0x00, 0x00, 0x00, 0x00, 0x00, 0x00, 0x00, 0x00, 0x00, 0x00, 0x00,
};
const unsigned char PROGMEM noWifi [] = {
0x00, 0x00, 0x00, 0x3F, 0xFC, 0x00, 0x00, 0x00, 0x00, 0x00, 0x03, 0xFF, 0xFF, 0xC0, 0x00, 0x00,
0x00, 0x00, 0x0F, 0xFF, 0xFF, 0xF0, 0x00, 0x00, 0x00, 0x00, 0x3F, 0xFF, 0xFF, 0xFC, 0x00, 0x00,
0x00, 0x00, 0xFF, 0x80, 0x01, 0xFF, 0x00, 0x00, 0x00, 0x03, 0xFC, 0x00, 0x00, 0x3F, 0xC0, 0x00,
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0x00, 0x00, 0x03, 0xFF, 0xFF, 0xC0, 0x00, 0x00, 0x00, 0x00, 0x00, 0x3F, 0xF8, 0x00, 0x00, 0x00,
};
const unsigned char PROGMEM fondoPantalla [] = {
0x00, 0x00, 0x00, 0x3F, 0x00, 0x00, 0x00, 0x00, 0x00, 0x00, 0x00, 0x00, 0x00, 0x00, 0x00, 0x00,
0x00, 0x00, 0x00, 0x7F, 0xC0, 0x00, 0x00, 0x00, 0x00, 0x00, 0x00, 0x00, 0x00, 0x00, 0x00, 0x00,
0x00, 0x00, 0x00, 0xFF, 0xE0, 0x00, 0x00, 0x00, 0x00, 0x00, 0x00, 0x00, 0x00, 0x00, 0x00, 0x00,
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0x00, 0x00, 0x00, 0x1E, 0x00, 0x00, 0x00, 0x00, 0x00, 0x00, 0x00, 0x00, 0x00, 0x00, 0x00, 0x00,
};

static const int servoDir = 5;
static const int servoSys = 19;
static const int servoCam = 17;
static const int  PWM_R = 35;
static const int  PWM_L = 34;

Servo M_L;
Servo M_R;
Servo direccion;
Servo Camara;
Servo Rampa;

// Definiciones de pines usados para los motores
static const int  PIN_MOTOR_R_FWD = 15;
static const int  PIN_MOTOR_R_BWD = 2;
static const int  PIN_MOTOR_L_BWD = 0;
static const int  PIN_MOTOR_L_FWD = 4;
static const int  LUZ = 25;
static const int  LEDON = 26;
static const int  LEDOFF= 14;
static const int  LEDC = 27;
static const int  BUM = 16;

//Configuración de red
const char* ssid     = "Alarcon";
const char* password = "51952792";


int x=0;
int y=0;
int grados=0;
int grados_cam=0;
int estateLed=0;

// Enumeración de comandos recibidos
enum Comandos {
  ADELANTE='w',
  ATRAS='s',
  IZQUIERDA_ADELANTE='a',
  DERECHA_ADELANTE='d',
  IZQUIERDA_ATRAS='f',
  DERECHA_ATRAS='h',
  IZQUIERDA='r',
  DERECHA='y',
  CMD_STOP = 'q',
  BAJAR_RAMP = 'b',
  MEDIA_RAMP = 'g',
  SUBIR_RAMP = 'v',
  BAJAR_CAMERA = 'c',
  SUBIR_CAMERA = 'n',
  ON_CANON = 'p',
  OFF_CANON = 'k',
  ON_LED = 'l',
  OFF_LED = 'm',
  LEFT_ADD = 'e',
  RIGHT_ADD = 'i',
  DIR_ADELANTE='j',
  APUNTAR_LEFT = 'z',
  APUNTAR_RIGHT = 't',
  APUNTAR_ADELANTE = 'o',
  APUNTAR_ATRAS = 'u'
};

WiFiServer TCPServer(8083);
WiFiClient TCPClient;

void byteReceived(byte byteReceived) {

    switch(byteReceived){

      case ADELANTE:
       Serial.println("Forward");
       display.setCursor(64,38);
       display.setTextColor(WHITE);
       display.print("Forward");
       digitalWrite(PIN_MOTOR_R_FWD, HIGH);
       digitalWrite(PIN_MOTOR_R_BWD, LOW);
       digitalWrite(PIN_MOTOR_L_FWD, HIGH);
       digitalWrite(PIN_MOTOR_L_BWD, LOW);
       display.display();
       Serial.print("Derecho");
      break;

      case ATRAS:

        Serial.println("Backward");
        display.setCursor(54,30);
       digitalWrite(PIN_MOTOR_R_FWD, LOW);
       digitalWrite(PIN_MOTOR_R_BWD, HIGH);
       digitalWrite(PIN_MOTOR_L_FWD, LOW);
       digitalWrite(PIN_MOTOR_L_BWD, HIGH);
       display.display();
      break;

      case IZQUIERDA_ADELANTE:

       Serial.println("ADELANTE IZQUIERDA");
       display.setCursor(54,30);
       display.display();
       grados=170;
       direccion.write(170);
       digitalWrite(PIN_MOTOR_R_FWD, HIGH);
       digitalWrite(PIN_MOTOR_R_BWD, LOW);
       digitalWrite(PIN_MOTOR_L_FWD, HIGH);
       digitalWrite(PIN_MOTOR_L_BWD, LOW);
      break;

      case DERECHA_ADELANTE:
       Serial.println("ADELANTE DERECHA");
       display.setCursor(54,30);
       display.display();
       grados=10;
       direccion.write(10);
       digitalWrite(PIN_MOTOR_R_FWD, HIGH);
       digitalWrite(PIN_MOTOR_R_BWD, LOW);
       digitalWrite(PIN_MOTOR_L_FWD, HIGH);
       digitalWrite(PIN_MOTOR_L_BWD, LOW);
      break;

      case IZQUIERDA_ATRAS:
       Serial.println("ATRAS IZQUIERDA");
       display.setCursor(54,30);
       display.display();
       grados=10;
       direccion.write(10);
       digitalWrite(PIN_MOTOR_R_FWD, LOW);
       digitalWrite(PIN_MOTOR_R_BWD, HIGH);
       digitalWrite(PIN_MOTOR_L_FWD, LOW);
       digitalWrite(PIN_MOTOR_L_BWD, HIGH);
      break;

      case DERECHA_ATRAS:
       Serial.println("ATRAS DERECHA");
       display.setCursor(54,30);
       display.display();
       grados=170;
       direccion.write(170);
       digitalWrite(PIN_MOTOR_R_FWD, LOW);
       digitalWrite(PIN_MOTOR_R_BWD, HIGH);
       digitalWrite(PIN_MOTOR_L_FWD, LOW);
       digitalWrite(PIN_MOTOR_L_BWD, HIGH);
      break;

      case DERECHA:
       digitalWrite(PIN_MOTOR_R_FWD, HIGH);
       digitalWrite(PIN_MOTOR_R_BWD, LOW);
       digitalWrite(PIN_MOTOR_L_FWD, LOW);
       digitalWrite(PIN_MOTOR_L_BWD, HIGH);
      break;

      case IZQUIERDA:
       digitalWrite(PIN_MOTOR_R_FWD, LOW);
       digitalWrite(PIN_MOTOR_R_BWD, HIGH);
       digitalWrite(PIN_MOTOR_L_FWD, HIGH);
       digitalWrite(PIN_MOTOR_L_BWD, LOW);
      break;


      case CMD_STOP:
        Serial.println("Stop ");
        display.setCursor(54,30);
        display.display();
        digitalWrite(PIN_MOTOR_R_FWD, LOW);
        digitalWrite(PIN_MOTOR_R_BWD, LOW);
        digitalWrite(PIN_MOTOR_L_FWD, LOW);
        digitalWrite(PIN_MOTOR_L_BWD, LOW);
      break;

      case BAJAR_RAMP:
        // Bajar la Rampa
        Rampa.write(0);
      break;

      case MEDIA_RAMP:
        Rampa.write(110);
      break;

      case SUBIR_RAMP:
        Rampa.write(180);
      break;

      case BAJAR_CAMERA:
        //Pendiente para calibrar
        grados_cam -= 10;
        if(grados_cam <= 20)
          grados_cam = 20;
        Camara.write(grados_cam);
      break;

      case SUBIR_CAMERA:
        // Pendiente
        grados_cam += 10;
        if(grados_cam >= 80)
          grados_cam = 80;
        Camara.write(grados_cam);
      break;

      case ON_CANON:
        digitalWrite(BUM, HIGH);
      break;

      case OFF_CANON:
        digitalWrite(BUM, LOW);
      break;

      case ON_LED:
        if(estateLed==0){
        digitalWrite(LUZ, HIGH);
        estateLed=1;
        }
        else{
        digitalWrite(LUZ, LOW);
        estateLed=0;
        }
      break;

      case OFF_LED:
        digitalWrite(LUZ, LOW);
      break;

      case LEFT_ADD:
        grados=grados-10;
        if(grados<=10){
          grados=10;
        }
        if(grados==170)
          grados = 120;

        direccion.write(grados);
      break;

      case RIGHT_ADD:
        grados=grados+10;
        if(grados>=170){
          grados=170;
        }
        if(grados==10)
          grados = 60;

        direccion.write(grados);
      break;

      case DIR_ADELANTE:
      if(grados==170){
          grados=120;
          direccion.write(grados);}
      if(grados==10){
        grados=140;
        direccion.write(grados);
      }
      break;

      case APUNTAR_LEFT:
        digitalWrite(PIN_MOTOR_R_FWD, LOW);
        digitalWrite(PIN_MOTOR_R_BWD, HIGH);
        digitalWrite(PIN_MOTOR_L_FWD, HIGH);
        digitalWrite(PIN_MOTOR_L_BWD, LOW);
        delay(100);
        digitalWrite(PIN_MOTOR_R_FWD, LOW);
        digitalWrite(PIN_MOTOR_R_BWD, LOW);
        digitalWrite(PIN_MOTOR_L_FWD, LOW);
        digitalWrite(PIN_MOTOR_L_BWD, LOW);
      break;

      case APUNTAR_RIGHT:
        digitalWrite(PIN_MOTOR_R_FWD, HIGH);
        digitalWrite(PIN_MOTOR_R_BWD, LOW);
        digitalWrite(PIN_MOTOR_L_FWD, LOW);
        digitalWrite(PIN_MOTOR_L_BWD, HIGH);
        delay(100);
        digitalWrite(PIN_MOTOR_R_FWD, LOW);
        digitalWrite(PIN_MOTOR_R_BWD, LOW);
        digitalWrite(PIN_MOTOR_L_FWD, LOW);
        digitalWrite(PIN_MOTOR_L_BWD, LOW);
      break;

      case APUNTAR_ADELANTE:
       digitalWrite(PIN_MOTOR_R_FWD, HIGH);
       digitalWrite(PIN_MOTOR_R_BWD, LOW);
       digitalWrite(PIN_MOTOR_L_FWD, HIGH);
       digitalWrite(PIN_MOTOR_L_BWD, LOW);
       delay(50);
       digitalWrite(PIN_MOTOR_R_FWD, LOW);
       digitalWrite(PIN_MOTOR_R_BWD, LOW);
       digitalWrite(PIN_MOTOR_L_FWD, LOW);
       digitalWrite(PIN_MOTOR_L_BWD, LOW);

      break;

      case APUNTAR_ATRAS:
      digitalWrite(PIN_MOTOR_R_FWD, LOW);
      digitalWrite(PIN_MOTOR_R_BWD, HIGH);
      digitalWrite(PIN_MOTOR_L_FWD, LOW);
      digitalWrite(PIN_MOTOR_L_BWD, HIGH);
      delay(50);
      digitalWrite(PIN_MOTOR_R_FWD, LOW);
      digitalWrite(PIN_MOTOR_R_BWD, LOW);
      digitalWrite(PIN_MOTOR_L_FWD, LOW);
      digitalWrite(PIN_MOTOR_L_BWD, LOW);
      break;

      default: break;

    }

}

void setup() {
  Serial.begin(115200);

pinMode(PIN_MOTOR_R_FWD, OUTPUT);
pinMode(PIN_MOTOR_R_BWD, OUTPUT);
pinMode(PIN_MOTOR_L_FWD, OUTPUT);
pinMode(PIN_MOTOR_L_BWD, OUTPUT);

pinMode(LUZ, OUTPUT);
pinMode(LEDON, OUTPUT);
pinMode(LEDOFF, OUTPUT);
pinMode(LEDC, OUTPUT);
pinMode(BUM, OUTPUT);

direccion.attach(servoDir);
Camara.attach(servoCam);
Rampa.attach(servoSys);
M_L.attach(PWM_L);
M_R.attach(PWM_R);

digitalWrite(PIN_MOTOR_R_FWD, LOW);
digitalWrite(PIN_MOTOR_R_BWD, LOW);
digitalWrite(PIN_MOTOR_L_FWD, LOW);
digitalWrite(PIN_MOTOR_L_BWD, LOW);
digitalWrite(LUZ, LOW);
digitalWrite(LEDON, LOW);
digitalWrite(LEDOFF, LOW);
digitalWrite(LEDC, LOW);
digitalWrite(BUM, LOW);
//pinMode(2,OUTPUT);

//analogWriteResolution(PWM_L, 14);
//analogWriteResolution(PWM_R, 14);

WiFi.begin(ssid, password);

TCPServer.begin();

 display.begin(SSD1306_SWITCHCAPVCC, 0x3C);
 display.display();

 display.begin(SSD1306_SWITCHCAPVCC, 0x3C);

display.clearDisplay();
display.display();
digitalWrite(LEDOFF, HIGH);
// Intentamos que se conecte a la red wifi
while(WiFi.status() != WL_CONNECTED) {
 Serial.println("Conectando...");
 delay(2000);
}

digitalWrite(LEDON, HIGH);
digitalWrite(LEDOFF,LOW);
Serial.print("Conectado.");
Serial.print(" Dirección IP del módulo: ");
Serial.println(WiFi.localIP());
Serial.println("Puerto: 8083");

display.fillScreen(0);          //Limpiamos la pantalla
display.drawBitmap(0,0,fondoPantalla,128,64,1);
display.display();
delay(1000);

display.fillScreen(0);
display.drawBitmap(0,0,atomo,128,64,1);
display.setTextSize(1);
display.setTextColor(WHITE);
display.setCursor(40,0);
display.println(WiFi.localIP());
display.display();

}

void loop() {
  if(WiFi.status() != WL_CONNECTED){
    digitalWrite(PIN_MOTOR_R_FWD, LOW);
    digitalWrite(PIN_MOTOR_R_BWD, LOW);
    digitalWrite(PIN_MOTOR_L_FWD, LOW);
    digitalWrite(PIN_MOTOR_L_BWD, LOW);
    digitalWrite(LEDOFF, HIGH);
    digitalWrite(LEDON, LOW);
    Serial.println("Disconected");
    display.drawBitmap(32,0,noWifi,128,64,1);
    display.print("Conectando...");
    while(WiFi.status() != WL_CONNECTED) {
      Serial.println("Conectando...");
      display.print(".");
      display.display();
      WiFi.begin(ssid, password);
      delay(2000);
      if(WiFi.status() == WL_CONNECTED){
        digitalWrite(LEDON, HIGH);
        digitalWrite(LEDOFF, LOW);
        Serial.print("Conectado.  ");
        Serial.print(" Dirección IP del módulo: ");
        Serial.println(WiFi.localIP());
        Serial.println("Puerto: 8083");
        display.fillScreen(0);
        display.drawBitmap(0,0,atomo,128,64,1);
        display.setCursor(40,0);
        display.print(WiFi.localIP());
        display.display();
        TCPServer.begin();
       }
      }
    }
    if (!TCPClient.connected()) {
      TCPClient = TCPServer.available();
      y=0;
      if(x==0){
      digitalWrite(LEDC, LOW);
      display.fillScreen(0);
      display.drawBitmap(0,0,atomo,128,64,1);
      display.setTextSize(1);
      display.setTextColor(WHITE);
      display.setCursor(40,0);
      display.println(WiFi.localIP());
      display.setCursor(60,18);
      display.println("Client");
      display.setCursor(60,28);
      display.setTextSize(1);
      display.println("Desconected");
      display.display();
      x=1;
      }
    }
    else
    {
      if (TCPClient.available() > 0) {
        byteReceived(TCPClient.read());
          x=0;
          if(y==0){
            display.fillScreen(0);
            display.drawBitmap(0,0,atomo,128,64,1);
            display.setTextSize(1);
            display.setTextColor(WHITE);
            display.setCursor(40,0);
            display.println(WiFi.localIP());
            display.println("          Client ok");
            display.display();
            y=1;
            digitalWrite(LEDC, HIGH);

          }

      }

   }


}
